## meta-sdk-ide/conf/layer.conf
```bitbake
# We have a conf and classes directory, add to BBPATH
BBPATH .= ":${LAYERDIR}"

# We have recipes-* directories, add to BBFILES
BBFILES += "${LAYERDIR}/recipes-*/*/*.bb \
            ${LAYERDIR}/recipes-*/*/*.bbappend"

BBFILE_COLLECTIONS += "meta-sdk-ide"
BBFILE_PATTERN_meta-sdk-ide = "^${LAYERDIR}/"
BBFILE_PRIORITY_meta-sdk-ide = "50"

LAYERDEPENDS_meta-sdk-ide = "core"
LAYERSERIES_COMPAT_meta-sdk-ide = "mickledore nanbield"
```
